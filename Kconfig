## Kconfig
```kconfig
# Per-key RGB lighting for the splitkb Aurora Lily58 (this repo's ZMK module).
# SPDX-License-Identifier: MIT

menuconfig ZMK_PRGB
    bool "Per-key RGB lighting (underglow + key zones, reactive effects)"
    depends on !ZMK_RGB_UNDERGLOW
    depends on SHIELD_SPLITKB_AURORA_LILY58_LEFT || SHIELD_SPLITKB_AURORA_LILY58_RIGHT
    select LED_STRIP
    select ZMK_LOW_PRIORITY_WORK_QUEUE
    # The WS2812 driver on this board talks SPI (stock underglow defaults SPI on too).
    imply SPI
    help
      Drives the zmk,underglow LED strip itself, instead of ZMK's RGB underglow:
      LEDs 0-4 are the underglow zone, 5-33 the per-key zone. Replaces
      CONFIG_ZMK_RGB_UNDERGLOW, which must be off. Controlled by the &prgb behavior
      (#include <behaviors/prgb.dtsi> in the keymap).

if ZMK_PRGB

config ZMK_PRGB_UNDERGLOW_LEDS
    int "Number of underglow LEDs at the start of the chain"
    default 5

config ZMK_PRGB_BRT_MAX
    int "Maximum brightness in percent (the 0-100 brightness setting is scaled to this)"
    range 1 100
    default 50

config ZMK_PRGB_BRT_START
    int "Initial brightness in percent of ZMK_PRGB_BRT_MAX"
    range 0 100
    default 100

config ZMK_PRGB_BRT_STEP
    int "Brightness step"
    range 1 100
    default 10

config ZMK_PRGB_HUE_STEP
    int "Hue step in degrees"
    range 1 359
    default 10

config ZMK_PRGB_SAT_STEP
    int "Saturation step"
    range 1 100
    default 10

config ZMK_PRGB_UG_HUE_START
    int "Initial underglow hue (0-359); also the accent colour of the reactive effects"
    range 0 359
    default 15

config ZMK_PRGB_UG_SAT_START
    int "Initial underglow saturation (0-100)"
    range 0 100
    default 100

config ZMK_PRGB_KEY_HUE_START
    int "Initial key hue (0-359)"
    range 0 359
    default 0

config ZMK_PRGB_KEY_SAT_START
    int "Initial key saturation (0-100); 0 = white"
    range 0 100
    default 0

config ZMK_PRGB_EFF_START
    int "Initial effect (0-5, see <dt-bindings/prgb.h>)"
    range 0 5
    default 0
    help
      0 static, 1 breathe, 2 reactive, 3 ripple, 4 rainbow, 5 heatmap.

config ZMK_PRGB_SPD_START
    int "Initial animation speed (1-5)"
    range 1 5
    default 3

config ZMK_PRGB_ON_START
    bool "Lighting on at first boot (before any saved state)"
    default y

config ZMK_PRGB_FADE_MS
    int "Reactive fade-out time in ms at speed 3 (scales inversely with speed)"
    range 50 10000
    default 1000

config ZMK_PRGB_BG_START
    int "Reactive/ripple background in percent of the brightness (0 = keys dark)"
    range 0 100
    default 0
    help
      What the keys rest at between presses in the reactive and ripple effects: a dim
      tint of the accent (underglow) colour, so a pressed key fades out in one colour.
      Initial value only; &prgb PRGB_BG_NEXT steps through 0, 5, 10, 15, 25 and is saved.

config ZMK_PRGB_FPS
    int "Animation frame rate (the timer only runs while something animates)"
    range 5 100
    default 40

config ZMK_PRGB_MAP_START
    bool "Layer key map on at first boot (before any saved state)"
    default y
    help
      While a layer above the default one is active, the keys show what is bound to them
      on that layer, by binding type, and the underglow takes the layer's tint (see
      src/prgb_ind.h). Toggled with &prgb PRGB_MAP_TOG and saved.

config ZMK_PRGB_PULSE_START
    bool "Underglow pulse on at first boot (before any saved state)"
    default y
    help
      The underglow rests at half its level and flashes up to full on every key press
      of that half, in every effect. Toggled with &prgb PRGB_PULSE_TOG and saved.

config ZMK_PRGB_PULSE_MS
    int "Underglow pulse length in ms at speed 3 (530-320 ms over speeds 1-5 at 400)"
    range 50 5000
    default 400

config ZMK_PRGB_CAPS_FALLBACK_POS
    int "Key position lit for caps lock when no key on any layer is bound to it"
    range 0 255
    default 24
    help
      While caps lock is on, the keys bound to caps lock on the active layers light up;
      if there are none, the keys bound to it on any layer; if there are none either,
      this key position (24: outer home-row key of the left half on the Lily58).

config ZMK_PRGB_AUTO_OFF_IDLE
    bool "Turn the LEDs off while the keyboard (this half) is idle"
    default y

endif # ZMK_PRGB

rsource "src/display/Kconfig"
```

## dts/bindings/behaviors/zmk,behavior-prgb.yaml
```yaml
# SPDX-License-Identifier: MIT

description: Per-key RGB lighting control (zones + effects)

compatible: "zmk,behavior-prgb"

include: two_param.yaml
```

## src/display/Kconfig
```kconfig
# Custom OLED status screen for the splitkb Aurora Lily58 (this repo's ZMK module).
# SPDX-License-Identifier: MIT

config ZMK_OLED_STATUS
    bool "Portrait status screen: battery voltage, lighting effect, connection, layer"
    default y
    depends on ZMK_DISPLAY_STATUS_SCREEN_CUSTOM
    select LV_USE_LABEL
    select LV_FONT_MONTSERRAT_8
    select LV_FONT_MONTSERRAT_10
    select LV_FONT_MONTSERRAT_12
    select ZMK_LOW_PRIORITY_WORK_QUEUE
    # The OLED shows the effect names from the &prgb behavior's ZMK Studio list.
    select ZMK_BEHAVIOR_METADATA if ZMK_PRGB
    imply LV_USE_THEME_MONO
    help
      Implements zmk_display_status_screen() for the 128x32 SSD1306 panels, shown
      rotated to portrait (32x128): connection (central: output / BLE profile;
      peripheral: link to the central), battery icon and voltage, active layer
      (central), per-key RGB effect and brightness. Needs
      CONFIG_ZMK_DISPLAY_STATUS_SCREEN_CUSTOM=y.

if ZMK_OLED_STATUS

choice ZMK_OLED_STATUS_ROTATION
    prompt "Direction the screen content is turned"
    default ZMK_OLED_STATUS_ROTATE_CW
    help
      The panel is mounted landscape; the stock screen reads upright on it. The content
      is turned by 90 degrees in software (the SSD1306 itself can only mirror).

config ZMK_OLED_STATUS_ROTATE_CW
    bool "90 degrees clockwise (top of the content towards the panel's right edge)"

config ZMK_OLED_STATUS_ROTATE_CCW
    bool "90 degrees counter-clockwise (top of the content towards the left edge)"

endchoice

config ZMK_OLED_STATUS_BATTERY_INTERVAL
    int "Seconds between battery voltage readings while active"
    range 5 3600
    default 60
    help
      Also read whenever ZMK's own battery level changes and 2 s after USB power is
      connected or removed. Readings pause while the keyboard is idle (screen off).

endif # ZMK_OLED_STATUS

# LVGL heap: the stock screen gets 4 KB (ZMK sets that only for the built-in screen).
config LV_Z_MEM_POOL_SIZE
    default 4096 if ZMK_OLED_STATUS
```
